## config/boards/shields/lunar/Kconfig.shield
```kconfig
config SHIELD_LUNAR_LEFT
	def_bool $(shields_list_contains,lunar_left)

config SHIELD_LUNAR_RIGHT
	def_bool $(shields_list_contains,lunar_right)
```

## config/boards/shields/slabboard/Kconfig.shield
```kconfig
config SHIELD_SLABBOARD_LEFT
	def_bool $(shields_list_contains,slabboard_left)

config SHIELD_SLABBOARD_RIGHT
	def_bool $(shields_list_contains,slabboard_right)
```
